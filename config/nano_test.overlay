/ {
    chosen {
        zmk,kscan = &kscan0;
    };
};

&kscan0 {
    compatible = "zmk,kscan-gpio-matrix";
    row-gpios = <&gpio0 6 GPIO_ACTIVE_LOW>, <&gpio0 8 GPIO_ACTIVE_LOW>;
    col-gpios = <&gpio0 17 GPIO_ACTIVE_LOW>, <&gpio0 20 GPIO_ACTIVE_LOW>;
    diode-direction = "row2col";
};
