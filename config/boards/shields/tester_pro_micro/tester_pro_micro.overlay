/ {
    chosen {
        zmk,kscan = &kscan0;
    };

    kscan0: kscan {
        compatible = "zmk,kscan-gpio-matrix";

        rows = <2>;
        cols = <2>;

        row-gpios = <
            &gpio0 6  (GPIO_ACTIVE_LOW | GPIO_PULL_UP)  /* ROW0 */
            &gpio0 8  (GPIO_ACTIVE_LOW | GPIO_PULL_UP)  /* ROW1 */
        >;

        col-gpios = <
            &gpio0 17 (GPIO_ACTIVE_LOW | GPIO_PULL_UP)  /* COL0 */
            &gpio0 20 (GPIO_ACTIVE_LOW | GPIO_PULL_UP)  /* COL1 */
        >;

        diode-direction = "col2row";
    };
};
